## drivers/leds/aw2027/Kconfig
```kconfig
config LEDS_AW2027
	tristate "LED Support for AW2027"
	depends on LEDS_CLASS && I2C
	help
		this option enables support for the AW2027 RGB LED connected
		through I2C. Say Y to enable support for the AW2027 LED
```

## drivers/leds/sgm31323/Kconfig
```kconfig
config LEDS_SGM31323
	tristate "LED Support for SGM31323"
	depends on LEDS_CLASS && I2C
	help
		this option enables support for the SGM31323 RGB LED connected
		through I2C. Say Y to enable support for the SGM31323 LED
```

## drivers/misc/mediatek/extcon/Kconfig
```kconfig
config EXTCON_MTK_USB
	tristate "MediaTek EXTCON USB Support"
	select EXTCON
	select USB_ROLE_SWITCH
	help
	  Say Y here to enable extcon support for USB cable detection
	  on the Mediatek PMIC.

config OPLUS_CHECK_SUB_NODE
	tristate "oplus CHECK SUB NODE Support"
	select EXTCON
	select USB_ROLE_SWITCH
	help
	  Say Y here to enable check sub node from devicetree .
```

## drivers/misc/mediatek/sensor/2.0/sensorhub/Kconfig
```kconfig
config MTK_SENSORHUB
	tristate "sensorhub architecture for MediaTek package"
	help
	  It support mediatek sensorhub architecture.
	  If this option is set,
	  it will support
	  mediatek sensorhub architecture.

config OPLUS_FEATURE_MTK_LOW_SENSOR_FREQ
	bool "Mediatek sensorhub with acc sensor freq set low"
		default n
		help
		  This is feature for acc sensor.
		  Say Y here if you want to set acc sensor freq is low.
		  Select this only if your board has this feature.
		  Say N here if you want to set acc sensor freq is high.
```
