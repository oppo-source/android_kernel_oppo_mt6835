/**********************************************************************************
* Copyright (c)  2008-2020  Guangdong oplus Mobile Comm Corp., Ltd
*
***********************************************************************************/
&odm {
        nfc_chipset:nfc_chipset {
                compatible = "oplus-nfc-chipset";
                chipset-24253 = "THN31";
               // manifest = "/odm/etc/vintf/manifest_nfc_thn31f.xml";
        };
};


&i2c0 {
       status = "okay";
       clock-frequency = <400000>;

       tms_thn31@28 {
               compatible = "tms,nfc";
               reg = <0x28>;
               tms,irq-gpio = <&pio 41 0x0>;
               tms,ven-gpio = <&pio 42 0x0>;
               //tms,download-gpio = <&pio 182 0x0>;
               interrupt-parent = <&pio>;
       };
};
